// SPDX-License-Identifier: BSD-3-Clause
/dts-v1/;
/plugin/;

/ {
	compatible = "asus,rog-phone5", "qcom,sm8350";
};

&{/} {
	pmic-glink {
		compatible = "qcom,sm8350-pmic-glink", "qcom,pmic-glink";
	};
};

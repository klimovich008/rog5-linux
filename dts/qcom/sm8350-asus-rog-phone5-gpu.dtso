// SPDX-License-Identifier: BSD-3-Clause
/dts-v1/;
/plugin/;

/ {
	compatible = "asus,rog-phone5", "qcom,sm8350";
};

&gpu {
	status = "okay";
};

&gpu_zap_shader {
	firmware-name = "qcom/sm8350/a660_zap.mbn";
};
